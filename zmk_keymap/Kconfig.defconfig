## zmk_keymap/Kconfig.defconfig
```kconfig
if SHIELD_DIGIT_LEFT || SHIELD_DIGIT_RIGHT
        

 config ZMK_SPLIT
        default y
endif 

if SHIELD_DIGIT_LEFT

config ZMK_KEYBOARD_NAME
    default "The Digit"
config ZMK_SPLIT_ROLE_CENTRAL
    default y
endif
```

## zmk_keymap/Kconfig.shield
```kconfig
config SHIELD_DIGIT_LEFT
	def_bool $(shields_list_contains,digit_left)

config SHIELD_DIGIT_RIGHT
	def_bool $(shields_list_contains,digit_right)
```
